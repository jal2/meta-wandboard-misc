## conf/layer.conf
```bitbake
# We have a conf and classes directory, append to BBPATH
BBPATH .= ":${LAYERDIR}"

BBFILES += "${LAYERDIR}/recipes*/*/*.bb ${LAYERDIR}/recipes*/*/*.bbappend ${LAYERDIR}/images/*.bb"

BBFILE_COLLECTIONS += "meta-wandboard-misc"
BBFILE_PATTERN_meta-wandboard-misc := "^${LAYERDIR}/"
BBFILE_PRIORITY_meta-wandboard-misc = "16"

LAYERSERIES_COMPAT_meta-wandboard-misc = "dunfell"
```
